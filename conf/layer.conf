## conf/layer.conf
```bitbake
# We have a conf and classes directory, add to BBPATH
BBPATH .= ":${LAYERDIR}"

# We have recipes-* directories, add to BBFILES
BBFILES += "${LAYERDIR}/recipes-*/*/*.bb \
            ${LAYERDIR}/recipes-*/*/*.bbappend"

BBFILE_COLLECTIONS += "meta-i2c-oled"
BBFILE_PATTERN_meta-i2c-oled = "^${LAYERDIR}/"
BBFILE_PRIORITY_meta-i2c-oled = "6"

LAYERDEPENDS_meta-i2c-oled = "core"
LAYERSERIES_COMPAT_meta-i2c-oled = "thud"
```
